## config/boards/shields/cybr36/Kconfig.defconfig
```kconfig
if SHIELD_CYBR36_RIGHT

config ZMK_KEYBOARD_NAME
    default "cybr36"

config ZMK_SPLIT_ROLE_CENTRAL
    default y

endif

if SHIELD_CYBR36_LEFT || SHIELD_CYBR36_RIGHT

config ZMK_SPLIT
    default y

endif
```

## config/boards/shields/cybr36/Kconfig.shield
```kconfig
config SHIELD_CYBR36_LEFT
    def_bool $(shields_list_contains,cybr36_left)

config SHIELD_CYBR36_RIGHT
    def_bool $(shields_list_contains,cybr36_right)
```
